## CMakeLists.txt
```
#-------------------------------------------------------------------------------
# Zephyr Example Application
#
# Copyright (c) 2021 Nordic Semiconductor ASA
# SPDX-License-Identifier: Apache-2.0

cmake_minimum_required(VERSION 3.13.1)
find_package(Zephyr REQUIRED HINTS $ENV{ZEPHYR_BASE})

project(app LANGUAGES C)

zephyr_include_directories(
  src/include
)

target_sources(app PRIVATE 
src/main.c
src/my_custom_code.c
src/my_custom_application_code.c
)
```

## prj.conf
```kconfig
# Copyright (c) 2021 Nordic Semiconductor ASA
# SPDX-License-Identifier: Apache-2.0
#
# This file contains selected Kconfig options for the application.
CONFIG_BOOT_BANNER=y
CONFIG_ZBUS=y
CONFIG_LOG=y
CONFIG_LOG_BACKEND_NATIVE_POSIX=y
CONFIG_LOG_BACKEND_SHOW_COLOR=y
CONFIG_LOG_MODE_IMMEDIATE=y
```

## src/main.c
```c
/*
 * Copyright (c) 2021 Nordic Semiconductor ASA
 * SPDX-License-Identifier: Apache-2.0
 */

#include <zephyr/kernel.h>
#include "my_custom_code.h"
#include "my_custom_application_code.h"

int main(void)
{
	int a = 100;
	a = a + 1;
	while (1)
	{
		k_sleep(K_SECONDS(2));
		add_100();
		add_200();
		k_sleep(K_SECONDS(2));
		log_time();
	}
}
```

## src/my_custom_application_code.c
```c
#include <zephyr/kernel.h>

#include <zephyr/logging/log.h>
#include "my_custom_code.h"
LOG_MODULE_REGISTER(applicationLog, LOG_LEVEL_DBG);

static int a = 0;

void log_time()
{
  uint64_t timeNow = k_uptime_get();
  LOG_DBG("%lld\n", timeNow);
}

int add_200()
{
  a = a + 200;
  return a;
}
```

## src/my_custom_code.c
```c
#include <zephyr/logging/log.h>
#include "my_custom_code.h"
LOG_MODULE_REGISTER(basicLog, LOG_LEVEL_DBG);

static int a = 0;

void log_100()
{
  LOG_DBG("%d\n", a);
}

int add_100()
{
  a = a + 100;
  return a;
}
```
